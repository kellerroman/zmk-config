## config/west.yml
```yaml
manifest:
  remotes:
    - name: zmkfirmware
      url-base: https://github.com/zmkfirmware
    - name: mousepr
      url-base: https://github.com/petejohanson
  projects:
    - name: zmk
      remote: mousepr
      revision: feat/pointers-move-scroll
      import: app/west.yml
  self:
    path: config
```
